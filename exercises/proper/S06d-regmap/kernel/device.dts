/dts-v1/;

/ {
    #address-cells = <2>;
    #size-cells = <2>;
    model = "oslab-s6d-virt";
    compatible = "oslab,s6d-virt";

    /* PLIC：核外中断控制器。reg=基址 0x0c000000 + 长度 0x4000000。
     * #address-cells=2 #size-cells=2 ⇒ reg = <addr_hi addr_lo size_hi size_lo>。 */
    plic@c000000 {
        compatible = "sifive,plic-1.0.0";
        reg = <0x0 0x0c000000 0x0 0x4000000>;
        interrupt-controller;
        #interrupt-cells = <1>;
        riscv,ndev = <0x35>;
    };

    /* NS16550 串口：reg 给出 MMIO 基址(0x10000000)与长度(0x100)。 */
    uart@10000000 {
        compatible = "ns16550a";
        reg = <0x0 0x10000000 0x0 0x100>;
        clock-frequency = <0x384000>;
    };
};
